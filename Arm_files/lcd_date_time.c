#include "lcd.h"
#include"types.h"
#include"delay.h"
#include"defines.h"
#include"lcd_defines.h"
#include<LPC21xx.h>
#define  Select 16
#define  INC 17
//#define  18
//#define  19
u32 dd=30,MM=11,yy=2024,hh=8,mm=40,ss,count=0;
main()
{
	initlcd();
	//cmdlcd(0x10);
	while(1)
	{
		/*if(((IOPIN1>>Select)&1)==0)
		{
			count++;
			if(count>7)
			{
				count=0;
			}
		}
		while(READBIT(IOPIN1,Select)==0);
		while(count==1)
		{
			if(((IOPIN1>>INC)&1)==0)
			{
				dd++;
				while(READBIT(IOPIN1,INC)==0);
				if(dd>31)
				{
					dd=1;
				}
			}
			if(((IOPIN1>>Select)&1)==0)
			{
				count++;
			}
			
		}
		while(count==2)
		{
			if(((IOPIN1>>INC)&1)==0)
			{
				MM++;
				while(READBIT(IOPIN1,INC)==0);
				if(MM>12)
				{
					MM=1;
				}
			}
			if(((IOPIN1>>Select)&1)==0)
			{
				count++;
			}
		}
		while(count==3)
		{
			if(((IOPIN1>>INC)&1)==0)
			{
				yy++;
				while(READBIT(IOPIN1,INC)==0);
				if(yy>2100)
				{
					yy=2000;
				}
			}
			if(((IOPIN1>>Select)&1)==0)
			{
				count++;
			}
		}
		while(count==4)
		{
			if(((IOPIN1>>INC)&1)==0)
			{
				hh++;
				while(READBIT(IOPIN1,INC)==0);
				if(hh>24)
				{
					hh=0;
				}
			}
			if(((IOPIN1>>Select)&1)==0)
			{
				count++;
			}
		}
		while(count==5)
		{
			if(((IOPIN1>>INC)&1)==0)
			{
				mm++;
				while(READBIT(IOPIN1,INC)==0);
				if(mm>60)
				{
					mm=0;
				}
			}
			if(((IOPIN1>>Select)&1)==0)
			{
				count++;
			}
		}
		while(count==6)
		{
			if(((IOPIN1>>INC)&1)==0)
			{
				ss++;
				while(READBIT(IOPIN1,INC)==0);
				if(ss>60)
				{
					ss=0;
				}
			}
			if(((IOPIN1>>Select)&1)==0)
			{
				count++;
			}
		}
		while((count==7||count==0)&&(((IOPIN1>>Select)&1)!=0))*/
		{
			strlcd("DATE:");
			U32lcd(dd);charlcd('-');U32lcd(MM);charlcd('-');U32lcd(yy);
			cmdlcd(GOTO_LINE2_POS0);
			strlcd("TIME:");
			U32lcd(hh);charlcd(':');U32lcd(mm);charlcd(':');U32lcd(ss);
			strlcd("     ");
			if(ss<61)
			{
				++ss;
				//lcdcmd;
			}
			if(ss==60)
			{
				ss=0;
				++mm;
				if(mm>=60)
				{	
					mm=0;
					++hh;
					if(hh>=24)
					{
						hh=0;
						++dd;
						if(dd>31)
						{
							dd=1;
							++MM;
							if(MM>12)
							{
								++yy;
								if(yy>2100)
								{
									yy=2000;
								}
							}
						}
					}
				}
			}
			delay_s(1);
		}
	}
}
		